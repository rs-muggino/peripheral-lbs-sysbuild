## build/peripheral_lbs/Kconfig/Kconfig.shield.defconfig
```kconfig
osource "D:/ncs/peripheral_lbs/boards/shields/*/Kconfig.defconfig"
osource "D:/ncs/v2.7.0/nrf/boards/shields/*/Kconfig.defconfig"
```

## build_flash/peripheral_lbs/Kconfig/Kconfig.shield.defconfig
```kconfig
osource "D:/ncs/peripheral_lbs/boards/shields/*/Kconfig.defconfig"
osource "C:/Users/Ryan/Downloads/peripheral-lbs-sysbuild-main/boards/shields/*/Kconfig.defconfig"
osource "D:/ncs/v2.7.0/nrf/boards/shields/*/Kconfig.defconfig"
```
